## CMakeLists.txt
```
cmake_minimum_required(VERSION 3.20.0)
find_package(Zephyr REQUIRED HINTS $ENV{ZEPHYR_BASE})

project(NodeB)

target_sources(app PRIVATE 
    src/main.c
    src/ble_scan.c
    src/sample.c
    src/usb_console.c
)

target_include_directories(app PRIVATE
    ${CMAKE_CURRENT_SOURCE_DIR}/include
)
```

## Kconfig.sysbuild
```
# Include zephyr konfig
source "${ZEPHYR_BASE}/share/sysbuild/Kconfig"
 
# Link Application core to Network Core
config NRF_DEFAULT_IPC_RADIO
default y

# Set Bluetooth Controller on Network Core
config NETCORE_IPC_RADIO_BT_HCI_IPC
default y
```

## prj.conf
```kconfig
# USB CDC ACM and naming
CONFIG_USB_DEVICE_STACK=y
CONFIG_USB_DEVICE_PRODUCT="Thingy91X CDC"
CONFIG_USB_DEVICE_MANUFACTURER="NTNU"
CONFIG_USB_CDC_ACM=y
CONFIG_UART_LINE_CTRL=y


# Console print
CONFIG_SERIAL=y
CONFIG_CONSOLE=y
CONFIG_PRINTK=y

# BLE
CONFIG_BT=y
CONFIG_BT_HCI=y
CONFIG_BT_OBSERVER=y
CONFIG_BT_CENTRAL=y
CONFIG_BT_SCAN=y

# libc / printf
CONFIG_NEWLIB_LIBC=y
CONFIG_CBPRINTF_FP_SUPPORT=y
```

## src/main.c
```c
#include "usb_console.h"
#include "ble_scan.h"
#include "sample.h"

#include <zephyr/kernel.h>
#include <zephyr/bluetooth/bluetooth.h>


static void bt_ready(int err)
{
    if (err) {
        printk("Bluetooth init failed (%d)\n", err);
        return;
    }

    printk("Bluetooth ready\n");

    sample_init();

    if (ble_scan_start()) {
        printk("Scan start failed\n");
        return;
    }

    printk("Scanning started\n");
}



int main(void)
{
    usb_console_init(3000);
    printk("Node B starting\n");

    int err = bt_enable(bt_ready);
    if (err) {
        printk("bt_enable failed (%d)\n", err);
        return 0;
    }

    while (1) {
        k_sleep(K_SECONDS(1));
    }
}
```

## include/ble_scan.h
```c
#pragma once

int ble_scan_start(void);
```

## include/protocol.h
```c
#pragma once

#include <stdint.h>
#include <zephyr/toolchain.h>
#include <zephyr/sys/util.h>


#define COMPANY_ID_NORDIC 0x0059
#define PROTO_MAGIC       0xA5
#define PROTO_VER         1

struct node_b_sample {
    int64_t ts_ms;
    uint16_t seq;
    int16_t  t_c_e2;
    uint16_t rh_e2;
    int32_t  lat_e7;
    int32_t  lon_e7;
    uint8_t  src;
    int8_t   rssi;
};

/* Manufacturer data format – Thingy Node A */
typedef struct __packed {
    uint16_t company_code;
    uint8_t  magic;
    uint8_t  ver;
    uint16_t seq;
    int16_t  t_c_e2;
    uint16_t rh_e2;
    int32_t  lat_e7;
    int32_t  lon_e7;
    uint8_t  src;
} adv_mfg_data_type;

BUILD_ASSERT(sizeof(adv_mfg_data_type) == 19,
             "size mismatch (expected 19 bytes)");
```

## include/sample.h
```c
#pragma once

#include "protocol.h"

void sample_init(void);
void sample_push(const struct node_b_sample *s);
```

## include/usb_console.h
```c
#pragma once
#include <stdint.h>

void usb_console_init(uint32_t timeout_ms);
```

## src/ble_scan.c
```c
#include "ble_scan.h"
#include "protocol.h"
#include "sample.h"

#include <zephyr/bluetooth/bluetooth.h>
#include <zephyr/bluetooth/hci.h>
#include <zephyr/sys/byteorder.h>
#include <zephyr/toolchain.h>

static int8_t last_rssi;

static void parse_adv_mfg_v1(const uint8_t *data, uint8_t len, int8_t rssi)
{
    if (len < sizeof(adv_mfg_data_type)) {
        return;
    }

    const adv_mfg_data_type *p = (const adv_mfg_data_type *)data;

    if (sys_le16_to_cpu(p->company_code) != COMPANY_ID_NORDIC ||
        p->magic != PROTO_MAGIC ||
        p->ver   != PROTO_VER) {
        return;
    }

    struct node_b_sample s = {
        .ts_ms  = k_uptime_get(),
        .seq    = sys_le16_to_cpu(p->seq),
        .t_c_e2 = sys_le16_to_cpu(p->t_c_e2),
        .rh_e2  = sys_le16_to_cpu(p->rh_e2),
        .lat_e7 = sys_le32_to_cpu(p->lat_e7),
        .lon_e7 = sys_le32_to_cpu(p->lon_e7),
        .src    = p->src,
        .rssi   = rssi
    };

    sample_push(&s);
}

static bool ad_parse_cb(struct bt_data *data, void *user_data)
{
    ARG_UNUSED(user_data); // dummy to make compiler happy

    if (data->type != BT_DATA_MANUFACTURER_DATA) {
        return true;
    }

    parse_adv_mfg_v1(data->data, data->data_len, last_rssi);
    return true;
}


static void scan_cb(const bt_addr_le_t *addr, int8_t rssi,
                    uint8_t adv_type, struct net_buf_simple *buf) 
{
    //printk("scan_cb: rssi=%d adv_type=%u len=%u\n", rssi, adv_type, buf->len);
    ARG_UNUSED(addr);
    ARG_UNUSED(adv_type);

    
    last_rssi = rssi;
    bt_data_parse(buf, ad_parse_cb, NULL);
}

int ble_scan_start(void)
{
    struct bt_le_scan_param scan_param = {
        .type     = BT_LE_SCAN_TYPE_PASSIVE,
        .options  = 0,
        .interval = BT_GAP_SCAN_FAST_INTERVAL,
        .window   = BT_GAP_SCAN_FAST_WINDOW,
    };

    return bt_le_scan_start(&scan_param, scan_cb);
}
```

## src/sample.c
```c
#include "sample.h"
#include <zephyr/kernel.h>
#include <stdio.h>


K_MSGQ_DEFINE(sample_q, sizeof(struct node_b_sample), 8, 8);

static void sample_to_json(const struct node_b_sample *s,
                           char *buf, size_t len)
{
    snprintf(buf, len,
        "{\"ts\":%u,\"seq\":%u,\"t_c_e2\":%d,\"rh_e2\":%u,"
        "\"lat_e7\":%d,\"lon_e7\":%d,\"src\":%u,\"rssi\":%d}",
        (uint32_t)s->ts_ms, s->seq, s->t_c_e2, s->rh_e2,
        s->lat_e7, s->lon_e7, s->src, s->rssi);
}

static void sample_worker(void)
{
    struct node_b_sample s;
    char json[192];

    while (1) {
        k_msgq_get(&sample_q, &s, K_FOREVER);
        sample_to_json(&s, json, sizeof(json));
        printk("%s\n", json);
    }
}

K_THREAD_DEFINE(sample_thread, 2048, sample_worker,
                NULL, NULL, NULL, 5, 0, 0);

void sample_push(const struct node_b_sample *s)
{
    //printk("sample_push called\n");
    k_msgq_put(&sample_q, s, K_NO_WAIT);
}

void sample_init(void)
{
}
```

## src/usb_console.c
```c
#include "usb_console.h"
#include <zephyr/usb/usb_device.h>
#include <zephyr/drivers/uart.h>
#include <zephyr/device.h>
#include <zephyr/kernel.h>

void usb_console_init(uint32_t timeout_ms)
{
    const struct device *dev = DEVICE_DT_GET(DT_CHOSEN(zephyr_console));
    uint32_t dtr = 0;
    uint32_t t0 = k_uptime_get();

    usb_enable(NULL);

    if (!device_is_ready(dev)) {
        return;
    }

    while (!dtr && (k_uptime_get() - t0 < timeout_ms)) {
        uart_line_ctrl_get(dev, UART_LINE_CTRL_DTR, &dtr);
        k_sleep(K_MSEC(50));
    }
}
```
