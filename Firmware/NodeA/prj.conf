## CMakeLists.txt
```
cmake_minimum_required(VERSION 3.20.0)
find_package(Zephyr REQUIRED HINTS $ENV{ZEPHYR_BASE})

project(NodeA)

target_sources(app PRIVATE 
    src/main.c
    src/sensors.c
)

target_include_directories(app PRIVATE
    ${CMAKE_CURRENT_SOURCE_DIR}/include
)
```

## prj.conf
```kconfig
CONFIG_LOG=y
CONFIG_LOG_MODE_IMMEDIATE=y
#CONFIG_LOG_DEFAULT_LEVEL=3

CONFIG_CBPRINTF_FP_SUPPORT=y


CONFIG_I2C=y
CONFIG_SENSOR=y
CONFIG_BME680=y


CONFIG_SERIAL=y
CONFIG_UART_CONSOLE=y
CONFIG_BOOTLOADER_MCUBOOT=y
CONFIG_USB_DEVICE_STACK=y
```

## boards/thingy91x_nrf9151_ns.overlay
```dts
&i2c2 {
    status = "okay";
};

&bme680 {
    status = "okay";
};
```

## src/main.c
```c
#include <zephyr/kernel.h>
#include <zephyr/logging/log.h>
#include <zephyr/drivers/i2c.h>
#include "sensors.h"

LOG_MODULE_REGISTER(app, LOG_LEVEL_INF);

int main(void)
{
    LOG_INF("App boot");

    int err = sensors_init();
    LOG_INF("sensors_init returned %d", err);

    while (1) {
        int val = sensors_sample_once();
        LOG_INF("main got %d", val);
        k_sleep(K_SECONDS(2));
    }
}
```

## include/gps.h
```c
#ifndef GPS_H
#define GPS_H

#ifdef __cplusplus
extern "C" {
#endif



#ifdef __cplusplus
}
#endif

#endif // SENSORS_H
```

## src/gps.c
```c
/*
#include <zephyr/kernel.h>
#include <zephyr/logging/log.h>
#include "gps.h"


LOG_MODULE_REGISTER(gps, LOG_LEVEL_INF);
*/
```

## src/sensors.c
```c
#include <zephyr/kernel.h>
#include <zephyr/logging/log.h>
#include "sensors.h"

LOG_MODULE_REGISTER(sensors, LOG_LEVEL_INF);

int sensors_init(void)
{
    LOG_INF("sensors_init() called");
    return 0;
}

int sensors_sample_once(void)
{
    static int counter;
    counter++;
    LOG_INF("sensors_sample_once(): counter=%d", counter);
    return counter;
}
```
