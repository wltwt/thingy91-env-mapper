## CMakeLists.txt
```
cmake_minimum_required(VERSION 3.20.0)
find_package(Zephyr REQUIRED HINTS $ENV{ZEPHYR_BASE})

project(NodeA)

target_sources(app PRIVATE 
    src/main.c
    src/sensors.c
    src/gps.c
)

target_include_directories(app PRIVATE
    ${CMAKE_CURRENT_SOURCE_DIR}/include
)
```

## Kconfig
```
#
# Copyright (c) 2019 Nordic Semiconductor ASA
#
# SPDX-License-Identifier: LicenseRef-Nordic-5-Clause
#

menu "cellfund Lesson 6 Exercise"


config GNSS_PERIODIC_INTERVAL
    int "Fix interval..."
    range 10 65535
    default 30

	help
	  Fix interval (in seconds) for periodic fixes.

# STEP 3.2 - Define configuration for fix timeout
config GNSS_PERIODIC_TIMEOUT
	int "Fix timeout for periodic GPS fixes"
	range 0 65535
	default 0
	help
	  Fix timeout (in seconds) for periodic fixes.
	  If set to zero, GNSS is allowed to run indefinitely until a valid PVT estimate is produced.

endmenu

menu "Zephyr Kernel"
source "Kconfig.zephyr"
endmenu
```

## prj.conf
```kconfig
# RTT LOG
CONFIG_LOG=n
CONFIG_LOG_MODE_IMMEDIATE=n
CONFIG_LOG_BACKEND_RTT=n
CONFIG_LOG_BACKEND_UART=n

# RTT core
CONFIG_USE_SEGGER_RTT=y



CONFIG_CONSOLE=y
CONFIG_PRINTK=y
CONFIG_RTT_CONSOLE=y
CONFIG_UART_CONSOLE=n


CONFIG_CBPRINTF_FP_SUPPORT=y

# I2C
CONFIG_I2C=y
CONFIG_SENSOR=y
CONFIG_BME680=y


# UART / Serial
CONFIG_SERIAL=y




# libc / float printf
CONFIG_NEWLIB_LIBC=y
CONFIG_NEWLIB_LIBC_FLOAT_PRINTF=y
CONFIG_FPU=y



# Memory
CONFIG_HEAP_MEM_POOL_SIZE=4096
CONFIG_MAIN_STACK_SIZE=4096



# GNSS
CONFIG_NRF_MODEM_LIB=y
CONFIG_LTE_LINK_CONTROL=y
CONFIG_LTE_NETWORK_MODE_LTE_M_NBIOT_GPS=y
CONFIG_MODEM_ANTENNA_GNSS_EXTERNAL=y
```

## boards/thingy91x_nrf9151_ns.overlay
```dts
&i2c2 {
    status = "okay";
};

&bme680 {
    status = "okay";
};

&uart0 {
    status = "okay";
    current-speed = <115200>;
};
```

## src/main.c
```c
#include <zephyr/kernel.h>
#include <zephyr/logging/log.h>
//#include <zephyr/drivers/i2c.h>


#include <zephyr/drivers/uart.h>
#include <zephyr/device.h>
#include <zephyr/devicetree.h>
#include <string.h>


#include "sensors.h"
#include "gps.h"
#include <zephyr/sys/byteorder.h>
#include <zephyr/sys/util.h>
#include <stdint.h>

#define PKT_MAGIC 0xA5
#define PKT_VER   1
#define SEND_INTERVAL 2

/* Initiate main logging */
LOG_MODULE_REGISTER(app, LOG_LEVEL_INF);


/*
struct __packed env_pkt_wire {
    uint8_t  magic;        // 0xA5
    //uint8_t  ver;          // 1
    //uint16_t seq_le;       // little-endian
    int16_t  t_c_e2_le;    // temp * 100
    uint16_t rh_e2_le;     // RH * 100
    int32_t  lat_e7_le;    // lat * 1e7
    int32_t  lon_e7_le;    // lon * 1e7
    //uint8_t  src;          // team id
    uint8_t  crc8;         // over bytes [magic..src]
};

*/


struct __packed state_payload_wire {
    uint8_t  magic;        // 0xA5
    int16_t  t_c_e2_le;    // temp * 100
    uint16_t rh_e2_le;     // RH * 100
    int32_t  lat_e7_le;    // lat * 1e7
    int32_t  lon_e7_le;    // lon * 1e7
    uint8_t  crc8;         // over bytes [magic..src]
};


//BUILD_ASSERT(sizeof(struct env_pkt_wire) == 1+1+2+2+2+4+4+1+1, "pkt size changed");

BUILD_ASSERT(sizeof(struct state_payload_wire) == 1+2+2+4+4+1, "pkt size changed");

static const struct device *uart = DEVICE_DT_GET(DT_NODELABEL(uart0));


static uint8_t crc8_atm(const uint8_t *data, size_t len)
{
    uint8_t crc = 0x00;
    for (size_t i = 0; i < len; i++) {
        crc ^= data[i];
        for (int b = 0; b < 8; b++) {
            crc = (crc & 0x80) ? (uint8_t)((crc << 1) ^ 0x07) : (uint8_t)(crc << 1);
        }
    }
    return crc;
}


static void build_pkt(struct state_payload_wire *p,
                      int16_t t_c_e2, uint16_t rh_e2,
                      int32_t lat_e7, int32_t lon_e7)
{
    p->magic = PKT_MAGIC;
    //p->ver   = PKT_VER;
    //p->seq_le    = sys_cpu_to_le16(g_seq++);
    p->t_c_e2_le = sys_cpu_to_le16((int16_t)t_c_e2);
    p->rh_e2_le  = sys_cpu_to_le16(rh_e2);
    p->lat_e7_le = sys_cpu_to_le32(lat_e7);
    p->lon_e7_le = sys_cpu_to_le32(lon_e7);
    //p->src = src;

    // CRC over alt uten crc8-feltet
    p->crc8 = crc8_atm((const uint8_t*)p, offsetof(struct state_payload_wire, crc8));
}



static void uart_send_pkt_poll(const struct device *uart, const struct state_payload_wire *p)
{
    update_env_sample();
    const uint8_t *b = (const uint8_t*)p;
    for (size_t i = 0; i < sizeof(*p); i++) {
        uart_poll_out(uart, b[i]);
    }
}


int main(void)
{

    int err = 0;

    err = gps_init();
    if (err != 0) {
        LOG_ERR("GPS ERROR");
        return 0;
    }



    err = sensors_init();
    if (err != 0) {
        return 0;
    }
 


    if (!device_is_ready(uart)) return 0;
    
    struct state_payload_wire pkt;
    struct env_sample ep;
    struct gps_sample gp;

    err = get_env(&ep);
    if (err != 0) {
        LOG_ERR("get env error");
    }

    LOG_INF("temp: %d, hum: %d",ep.t_c_e2, ep.rh_e2);

    /*
    //disable static test data
    int16_t  t_c_e2 = 2231;        // 22.31°C
    uint16_t rh_e2  = 4890;        // 48.90%
    int32_t  lat_e7 = 599139000;   // 59.9139000
    int32_t  lon_e7 = 107522000;   // 10.7522000
    uint8_t  src    = 3;
    
    */
    
    while (1) {
        get_env(&ep);
        get_gps_payload(&gp);

        build_pkt(&pkt, ep.t_c_e2, ep.rh_e2, gp.lat_e7, gp.lon_e7);
        
        uart_send_pkt_poll(uart, &pkt);
        
        k_sleep(K_SECONDS(SEND_INTERVAL));
    }
}
```

## include/gps.h
```c
#ifndef GPS_H
#define GPS_H

#ifdef __cplusplus
extern "C" {
#endif


struct gps_sample {
    int32_t lat_e7;     // degrees * 1e7
    int32_t lon_e7;     // degrees * 1e7
    int64_t ts_ms;      // k_uptime_get()
    bool    fix_valid;
};

int gps_init(void);
int get_gps_payload(struct gps_sample *out);

#ifdef __cplusplus
}
#endif

#endif // SENSORS_H
```

## include/sensors.h
```c
#ifndef SENSORS_H
#define SENSORS_H

#ifdef __cplusplus
extern "C" {
#endif

struct env_sample {
    int16_t  t_c_e2;
    uint16_t rh_e2;
};


int sensors_init(void);
int update_env_sample(void);
int get_env(struct env_sample *pkt);

#ifdef __cplusplus
}
#endif

#endif // SENSORS_H
```

## src/gps.c
```c
/*
gps.c


INFO:
https://academy.nordicsemi.com/courses/cellular-iot-fundamentals/lessons/lesson-6-cellular-fundamentals/topic/lesson-6-gnss/
*/
#include <ncs_version.h>



#include <stdio.h>
#include <ncs_version.h>
#include <zephyr/kernel.h>

#include <zephyr/logging/log.h>
#include <modem/nrf_modem_lib.h>
#include <modem/lte_lc.h>
//#include <dk_buttons_and_leds.h>

/* STEP 4 - Include the header file for the GNSS interface */
#include <nrf_modem_gnss.h>

#include "gps.h"


LOG_MODULE_REGISTER(gps, LOG_LEVEL_INF);


static struct nrf_modem_gnss_pvt_data_frame pvt_data;


static int64_t gnss_start_time;


static bool first_fix = false;
static bool initialized = false;


static struct gps_sample payload;


static K_SEM_DEFINE(lte_connected, 0, 1);

static int32_t deg_to_e7(double deg)
{
    return (int32_t)(deg * 10000000.0);
}

static int modem_configure(void)
{
	int err;

	LOG_INF("Initializing modem library");

	err = nrf_modem_lib_init();
	if (err) {
		LOG_ERR("Failed to initialize the modem library, error: %d", err);
		return err;
	}

	return 0;
}

static void set_fix_data(struct nrf_modem_gnss_pvt_data_frame *pvt_data)
{
	payload.lat_e7 = deg_to_e7(pvt_data->latitude);
	payload.lon_e7 = deg_to_e7(pvt_data->longitude);

    LOG_INF("Found latitude: %d, longitude: %d", payload.lat_e7, payload.lon_e7);

	
	LOG_INF("Latitude:       %.06f", pvt_data->latitude);
	LOG_INF("Longitude:      %.06f", pvt_data->longitude);
	LOG_INF("Altitude:       %.01f m", (double)pvt_data->altitude);
	LOG_INF("Time (UTC):     %02u:%02u:%02u.%03u",
	       pvt_data->datetime.hour,
	       pvt_data->datetime.minute,
	       pvt_data->datetime.seconds,
	       pvt_data->datetime.ms);

}

static void gnss_event_handler(int event)
{
    int err;

    switch (event) {
    case NRF_MODEM_GNSS_EVT_PVT: {
        err = nrf_modem_gnss_read(&pvt_data, sizeof(pvt_data), NRF_MODEM_GNSS_DATA_PVT);
        if (err) {
            LOG_ERR("nrf_modem_gnss_read failed, err %d", err);
            return;
        }

        static int64_t last_log_ms = 0;
        const int64_t now = k_uptime_get();
        const bool do_log = (now - last_log_ms) >= 1000;

        int tracked = 0;
        int strong  = 0;

        for (int i = 0; i < 12; i++) {
            if (pvt_data.sv[i].cn0 > 0) {
                tracked++;
                if (pvt_data.sv[i].cn0 >= 200) {
                    strong++;
                }
            }
        }

        if (do_log) {
            last_log_ms = now;

            int32_t lat_e7 = (int32_t)(pvt_data.latitude  * 10000000.0);
            int32_t lon_e7 = (int32_t)(pvt_data.longitude * 10000000.0);

            LOG_INF("GNSS: flags=0x%08x tracked=%d strong=%d lat_e7=%d lon_e7=%d",
                    pvt_data.flags, tracked, strong, lat_e7, lon_e7);

            for (int i = 0; i < 12; i++) {
                if (pvt_data.sv[i].cn0 > 0) {
                    LOG_INF("  sv=%u sig=%u cn0=%u",
                            pvt_data.sv[i].sv,
                            pvt_data.sv[i].signal,
                            pvt_data.sv[i].cn0);
                }
            }
        }

        payload.ts_ms = now;

        if (pvt_data.flags & NRF_MODEM_GNSS_PVT_FLAG_FIX_VALID) {
            payload.fix_valid = true;
            set_fix_data(&pvt_data);

            if (!first_fix) {
                first_fix = true;
                LOG_INF("Time to first fix: %lld s",
                        (k_uptime_get() - gnss_start_time) / 1000);
            }
        } else {
            payload.fix_valid = false;
            payload.lat_e7 = 0;
            payload.lon_e7 = 0;
        }
        break;
    }

    case NRF_MODEM_GNSS_EVT_PERIODIC_WAKEUP:
        LOG_INF("GNSS has woken up");
        break;

    case NRF_MODEM_GNSS_EVT_SLEEP_AFTER_FIX:
        LOG_INF("GNSS enter sleep after fix");
        break;

    default:
        break;
    }
}


int gps_init(void)
{
    int err;

    err = modem_configure();
    if (err) return err;

    if (lte_lc_func_mode_set(LTE_LC_FUNC_MODE_ACTIVATE_GNSS) != 0) {
        LOG_ERR("Failed to activate GNSS functional mode");
        return 0;
    }	


    err = nrf_modem_gnss_event_handler_set(gnss_event_handler);
    if (err) return err;


    
    if (nrf_modem_gnss_fix_interval_set(CONFIG_GNSS_PERIODIC_INTERVAL) != 0) {
        LOG_ERR("Failed to set GNSS fix interval");
        return 0;
    }

    if (nrf_modem_gnss_fix_retry_set(CONFIG_GNSS_PERIODIC_TIMEOUT) != 0) {
        LOG_ERR("Failed to set GNSS fix retry");
        return 0;
    }
    

    //nrf_modem_gnss_fix_interval_set(1);
    //nrf_modem_gnss_fix_retry_set(180);


    gnss_start_time = k_uptime_get();
    LOG_INF("Starting GNSS");
    if (nrf_modem_gnss_start() != 0) {
        LOG_ERR("Failed to start GNSS");
        return 0;
    }

    payload.fix_valid = false;
    payload.lat_e7 = 0;
    payload.lon_e7 = 0;
    payload.ts_ms = k_uptime_get();
    initialized = true;

    return 0;
}


int get_gps_payload(struct gps_sample *pkt) {
	if (!initialized) return -EINVAL;
	*pkt = payload;
	return 0;
}
```

## src/sensors.c
```c
/*
* sensors.c
* 
* Get temperature values and such.
*
* Code is heavily referenced from nordic's courses 
* also example code shown in link below
* 
* https://docs.zephyrproject.org/latest/hardware/peripherals/sensor/fetch_and_get.html#sensor-fetch-and-get
* 
*/

#include <zephyr/kernel.h>
#include <zephyr/logging/log.h>
#include <zephyr/drivers/i2c.h>
#include <zephyr/drivers/sensor.h>

#include "sensors.h"

/* Get bme680  */
#define BME_NODE DT_NODELABEL(bme680)

/* Initialize logging module for sensors */
LOG_MODULE_REGISTER(sensors, LOG_LEVEL_INF);

/* Get pointer for bme68x-sensor */
static const struct device *bme = DEVICE_DT_GET(BME_NODE);

/* Initialize env-sample package */
static struct env_sample env_payload;


/* Convert floating point to integer 
*  for avoiding trouble in ble packet transfer
*/
static int16_t temperature_conv(const struct sensor_value *v)
{
    return (int16_t)(v->val1 * 100 + v->val2 / 10000);
}

/* Same purpose as above function */
static uint16_t humidity_conv(const struct sensor_value *v)
{
    int32_t x = v->val1 * 100 + v->val2 / 10000;
    return (uint16_t)x;
}



int sensors_init(void)
{

    if (!device_is_ready(bme)) {
        LOG_INF("BME68x device not ready\n");
        return 0;
    }
    
    LOG_INF("sensors_init() called");
    return 0;
}



int update_env_sample(void)
{
    struct sensor_value t, h;

    int err = sensor_sample_fetch(bme);
    if (err != 0) {
        return err;
    }

    /* Put temperature values in local payload */
    sensor_channel_get(bme, SENSOR_CHAN_AMBIENT_TEMP, &t);
    env_payload.t_c_e2 = temperature_conv(&t);

    /* Put realtive humidity in local payload */
    sensor_channel_get(bme, SENSOR_CHAN_HUMIDITY, &h);
    env_payload.rh_e2 = humidity_conv(&h);

    //LOG_INF("T=%d C, H=%d\n", env_payload.t_c_e2, env_payload.rh_e2);
    return 0;
}

int get_env(struct env_sample *pkt) {
    update_env_sample();
    *pkt = env_payload;
    return 0;
}
```
